## config/boards/shields/blanck40/Kconfig.defconfig
```kconfig
if SHIELD_BLANCK40

config ZMK_KEYBOARD_NAME
    default "blanck40"
CONFIG_ZMK_BEHAVIOR_RNG_TYPER=y
CONFIG_ENTROPY_GENERATOR=y          # usually already on for nice!nano
endif
```

## config/west.yml
```yaml
manifest:
  defaults:
    revision: v0.3
  remotes:
    - name: zmkfirmware
      url-base: https://github.com/zmkfirmware
    - name: mikel247                     
      url-base: https://github.com/mikel247
    # Additional modules containing boards/shields/custom code can be listed here as well
    # See https://docs.zephyrproject.org/3.2.0/develop/west/manifest.html#projects
  projects:
    - name: zmk
      remote: zmkfirmware
      import: app/west.yml

       - name: zmk-rng-behavior                # ← add this
      remote: mikel247
      revision: main

  self:
    path: config
```
